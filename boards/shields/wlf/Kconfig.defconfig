## boards/shields/wlf/Kconfig.defconfig
```kconfig
if SHIELD_WLF_LEFT

config ZMK_KEYBOARD_NAME
    default "The Wolf"

config ZMK_SPLIT_ROLE_CENTRAL
    default y

endif

if SHIELD_WLF_LEFT || SHIELD_WLF_RIGHT

config ZMK_SPLIT
    default y

config BT_CTLR
    default BT

if ZMK_BACKLIGHT

config PWM
    default y

config LED_PWM
    default y

endif

endif
```

## boards/shields/wlf/Kconfig.shield
```kconfig
config SHIELD_WLF_LEFT
    def_bool $(shields_list_contains,wlf_left)

config SHIELD_WLF_RIGHT
    def_bool $(shields_list_contains,wlf_right)
```

## config/west.yml
```yaml
manifest:
  remotes:
    - name: zmkfirmware
      url-base: https://github.com/zmkfirmware
    - name: willACosta
      url-base: https://github.com/WillACosta
  projects:
    - name: zmk
      remote: zmkfirmware
      revision: main
      import: app/west.yml
    - name: zmk-rgbled-widget
      remote: willACosta
      revision: main
      path: modules/zmk-rgbled-widget
    - name: prospector-zmk-module
      remote: willACosta
      revision: main
      path: modules/prospector-zmk-module
  self:
    path: config
```
